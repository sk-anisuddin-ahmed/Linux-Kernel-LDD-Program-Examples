/dts-v1/;
/plugin/;
 
/ {
    fragment@0 {
        target = <&am33xx_pinmux>;
        __overlay__ {
            lcd16x2_pins: lcd16x2_pins {
                pinctrl-single,pins = <
                    0x034 0x07  /* P8_11  gpio1_13 */
                    0x030 0x07  /* P8_12  gpio1_12 */
                    0x09C 0x07  /* P8_14  gpio0_26 */
                    0x098 0x07  /* P8_16  gpio1_14 */
                    0x08C 0x07  /* P8_18  gpio2_1  */
                    0x07C 0x07  /* P8_26  gpio1_29 */
				>;
            };
        };
    };
 
    fragment@1 {
        target-path = "/";
        __overlay__ {
            lcd16x2 {
                status = "okay";
 
                pinctrl-names = "default";
                pinctrl-0 = <&lcd16x2_pins>;
 
                rs-gpio = <&gpio1 13 0>;
                en-gpio = <&gpio1 12 0>;
                d4-gpio = <&gpio0 26 0>;
                d5-gpio = <&gpio1 14 0>;
                d6-gpio = <&gpio2 1  0>;
                d7-gpio = <&gpio1 29 0>;
            };
        };
    };
};